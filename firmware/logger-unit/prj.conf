## CMakeLists.txt
```
# SPDX-License-Identifier: Apache-2.0

cmake_minimum_required(VERSION 3.20.0)
find_package(Zephyr REQUIRED HINTS $ENV{ZEPHYR_BASE})
project(observer)

target_sources(app PRIVATE
  src/main.c
  src/observer.c
  src/advertisement/advertisement.c
)
```

## prj.conf
```kconfig
CONFIG_BT=y
CONFIG_BT_OBSERVER=y

# Is already enabled in 
# CONFIG_BT_DEBUG_LOG=y

# Disable SMPS (external inductors not soldered)
CONFIG_BOARD_ENABLE_DCDC=n
# Use internal 32k oscillator
CONFIG_CLOCK_CONTROL_NRF_K32SRC_RC=y

# Enable the I²C bus
CONFIG_I2C=y

# *** ADDED from ADC example *** #
CONFIG_ADC=y


# CONFIG_I2C_NRFX=y

# # CONFIG_NRFX_TWI=y
# CONFIG_NRFX_TWI0=y
# CONFIG_NRFX_TWI1=y
```

## src/main.c
```c
/*
 * Copyright (c) 2022 Nordic Semiconductor ASA
 *
 * SPDX-License-Identifier: Apache-2.0
 */

#include <zephyr/sys/printk.h>
#include <zephyr/bluetooth/bluetooth.h>
#include <zephyr/drivers/gpio.h>

#include <zephyr/device.h>
#include <zephyr/devicetree.h>
#include <zephyr/drivers/i2c.h>
// #include <stderr.h>
#include <stdint.h>
#include <stddef.h>

#include "stdio.h"

#include "advertisement/advertisement.h"

int observer_start(void);

#define LED0_NODE DT_ALIAS(led0)	// The devicetree node identifier for the "led0" alias.
// #define LED0_NODE DT_ALIAS(led0)	// The devicetree node identifier for the "led0" alias.


/* STATIC constants */
static const struct gpio_dt_spec led = GPIO_DT_SPEC_GET(LED0_NODE, gpios);

// static int16_t read_channel(uint8_t channel);

extern int16_t channel_voltage [4];

extern int16_t uav_battery_voltage_mv;
extern int16_t uav_current_ma;
extern int16_t pre_reg_input_current_ma;
extern int16_t pre_reg_output_current_ma; 

/* size of stack area used by each thread */
#define STACKSIZE 1024

/* scheduling priority used by each thread */
#define ADC_PRIORITY 8
#define ADV_PRIORITY 7

// *** START THREADS *** //
// K_THREAD_DEFINE(start_adv_id, STACKSIZE, adv_start, NULL, NULL, NULL, ADV_PRIORITY, 0, 0);


extern int16_t three_volt_supply_voltage_mv;
extern int16_t five_volt_supply_voltage_mv;
extern int16_t vamp_supply_voltage_mv;

int main(void)
{
	int err;

	gpio_pin_configure_dt(&led, GPIO_OUTPUT_INACTIVE);		// 

	printk("Start");

	gpio_pin_set_dt(&led, 1);

	/* Initialize the Bluetooth Subsystem */
	err = bt_enable(NULL);
	if (err) {
		printk("Bluetooth init failed (err %d)\n", err);
		return 0;
	}

	
	// gpio_pin_configure_dt(&led, GPIO_OUTPUT_INACTIVE);

	
	gpio_pin_toggle_dt(&led);

    // Start observer *** CURRENTLY DISABLE OBSERVER ***
	(void)observer_start();

    // Init peripherals (ADS and programmable load)
    // perihperals_init();

	// Set prereg on 10V
	// peripherals_set_pre_reg_voltage(4000);

	while (1)
	{
		gpio_pin_toggle_dt(&led);
		k_msleep(500);

        // peripherals_update_all_ads1115_channels();


        // for(int i = 0; i < ADS1115_NUMBER_OF_CHANNELS; i++){
        //     //printk("Channel %d: %d mV\n", i, channel_voltage[i]);

		// 	printk("Res %d: %d mV\n", i, channel_result [i]);
		// }

        // test res
        // TPL0401x_update_resistance(100);

        // peripherals_set_pre_reg_voltage(10000);
        
        // k_msleep(2000);
        
        // peripherals_set_pre_reg_voltage(5000);

        // test res
        // TPL0401x_update_resistance(25);

	}


	printk("Exiting %s thread.\n", __func__);
	return 0;
}
```

## src/observer.c
```c
/*
 * Copyright (c) 2022 Nordic Semiconductor ASA
 * Copyright (c) 2015-2016 Intel Corporation
 *
 * SPDX-License-Identifier: Apache-2.0
 */

#include <zephyr/sys/printk.h>
#include <zephyr/bluetooth/bluetooth.h>
#include <zephyr/bluetooth/hci.h>
// #include <bluetooth/scan.h>

// #define DEBUG_ADV_RAW_DATA

#define NAME_LEN 30

#define RX_DEVICE_NAME "wpt-receiver"
#define TX_DEVICE_NAME "wpt-transmitter"

// Receiver device variables
int16_t input_voltage_mv;
int16_t supply_voltage_mv;
int16_t buck_current_ma;

// Transmitter device variables
int16_t uav_battery_voltage_mv;
int16_t uav_current_ma;
int16_t pre_reg_input_current_ma;
int16_t pre_reg_output_current_ma;
int16_t vamp_supply_voltage_mv;


char rx_device_name_buffer [] = RX_DEVICE_NAME;
char tx_device_name_buffer [] = TX_DEVICE_NAME;
char *device_name_pointer_buffer [] = {rx_device_name_buffer, tx_device_name_buffer};
uint8_t device_name_len_buffer [] = {sizeof(rx_device_name_buffer), sizeof(tx_device_name_buffer)};
typedef enum{RX_DEVICE, TX_DEVICE, NONE} Devices;


// Static functions
static void extract_rx_data(uint8_t *buffer, uint8_t len);
static void extract_tx_data(uint8_t *buffer, uint8_t len);
static void print_buffer(uint8_t *buffer, uint8_t len);


uint8_t check_device(struct net_buf_simple *ad){

	for(uint8_t device = RX_DEVICE; device <= TX_DEVICE; device++){
		// Desired - buffer name rx adv
		// char ds_name_buffer [] = RX_DEVICE_NAME;
		uint16_t buffer_cmp_len = device_name_len_buffer[device] - 1;//sizeof(device_name_pointer_buffer[device]) - 1;

		// Scanned - buffer name rx adv
		char sc_name_buffer [buffer_cmp_len];
		memcpy(sc_name_buffer, ad->data + 2, buffer_cmp_len);
		
		// Print buffers to check similarity
		// print_buffer(ds_name_buffer, buffer_cmp_len);
		// print_buffer(sc_name_buffer, buffer_cmp_len);

		// Compare both buffer
		int result = memcmp(device_name_pointer_buffer[device], sc_name_buffer, buffer_cmp_len);

		if(result == 0){
			return device;
		}
	}
	return NONE;
}

static void device_found(const bt_addr_le_t *addr, int8_t rssi, uint8_t type, struct net_buf_simple *ad){

	char addr_str[BT_ADDR_LE_STR_LEN];

	uint8_t dev = check_device(ad);

	#ifdef DEBUG_ADV_RAW_DATA 
		if(dev != NONE){
			printk("Device found: %s (RSSI %d), type %u, AD data len %u\n",
			addr_str, rssi, type, ad->len);
			print_buffer(ad->data, ad->len);
		}
	#endif

	switch (dev){
		case RX_DEVICE:
			bt_addr_le_to_str(addr, addr_str, sizeof(addr_str));

			extract_rx_data(ad->data, ad->len);

			printk("RECEIVER: input_voltage_mv: %"PRId32" mV\n", input_voltage_mv);
			printk("RECEIVER: supply_voltage_mv: %"PRId32" mV\n", supply_voltage_mv);
			printk("RECEIVER: buck_current_ma: %"PRId32" mA\n", buck_current_ma);

			break;

		
		case TX_DEVICE:
			bt_addr_le_to_str(addr, addr_str, sizeof(addr_str));

			extract_tx_data(ad->data, ad->len);

			// printk("TRANSMITTER: uav_battery_voltage_mv: %"PRId32" mV\n", uav_battery_voltage_mv);
			// printk("TRANSMITTER: uav_current_ma: %"PRId32" mA\n", uav_current_ma);
			// printk("TRANSMITTER: pre_reg_input_current_ma: %"PRId32" mA\n", pre_reg_input_current_ma);
			// printk("TRANSMITTER: pre_reg_output_current_ma: %"PRId32" mA\n", pre_reg_output_current_ma);
			printk("TRANSMITTER: vamp_supply_voltage_mv: %"PRId32" mV\n", vamp_supply_voltage_mv);

			break;
		
		default:
			break;
	}

	// // Desired - buffer name rx adv
	// char ds_name_buffer [] = RX_DEVICE_NAME;
	// uint8_t buffer_cmp_len = sizeof(ds_name_buffer) - 1;

	// // Scanned - buffer name rx adv
	// char sc_name_buffer [buffer_cmp_len];
	// memcpy(sc_name_buffer, ad->data + 2, buffer_cmp_len);
	
	// // Print buffers to check similarity
	// // print_buffer(ds_name_buffer, buffer_cmp_len);
	// // print_buffer(sc_name_buffer, buffer_cmp_len);

	// // Compare both buffer
	// int result = memcmp(ds_name_buffer, sc_name_buffer, buffer_cmp_len);

	// if(result == 0){
	// 	bt_addr_le_to_str(addr, addr_str, sizeof(addr_str));
		
	// 	#ifdef(DEBUG_ADV_RAW_DATA)
	// 		printk("Device found: %s (RSSI %d), type %u, AD data len %u\n",
	// 			addr_str, rssi, type, ad->len);

	// 		print_buffer(ad->data, ad->len);
	// 	#endif

	// 	extract_data(ad->data, ad->len);

	// 	printk("input_voltage_mv: %"PRId32" mV\n", input_voltage_mv);
	// 	printk("supply_voltage_mv: %"PRId32" mV\n", supply_voltage_mv);
	// 	printk("buck_current_ma: %"PRId32" mA\n", buck_current_ma);
	// }
}


/********************************************************************/
/*							START OBSERVER							*/
/********************************************************************/

int observer_start(void)
{
	struct bt_le_scan_param scan_param = {
		.type       = BT_LE_SCAN_TYPE_PASSIVE,
		.options    = BT_LE_SCAN_OPT_FILTER_DUPLICATE,
		.interval   = BT_GAP_SCAN_FAST_INTERVAL,
		.window     = BT_GAP_SCAN_FAST_WINDOW,
	};
	int err;


	// while(1){
	err = bt_le_scan_start(&scan_param, device_found);
	if (err) {
		printk("Start scanning failed (err %d)\n", err);
		return err;
	}
	printk("Started scanning...\n");

	return 0;
}

/********************************************************************/
/*							OTHER FUNCTIONS							*/
/********************************************************************/


static void extract_rx_data(uint8_t *buffer, uint8_t len){
	uint8_t pos = 4 + device_name_len_buffer[RX_DEVICE];
	input_voltage_mv = *(buffer + pos) << 8 | *(buffer + pos + 1);
	supply_voltage_mv = *(buffer + pos + 2) << 8 | *(buffer + pos + 3);
	buck_current_ma = *(buffer + pos + 4) << 8 | *(buffer + pos + 5);
}

static void extract_tx_data(uint8_t *buffer, uint8_t len){
	int16_t *extract_pointer_buffer [] = {&uav_battery_voltage_mv, &uav_current_ma, &pre_reg_input_current_ma, &pre_reg_output_current_ma, &vamp_supply_voltage_mv};
	
	// Adv start position user data
	uint8_t pos = 4 + device_name_len_buffer[TX_DEVICE];

	for(uint8_t i = 0; i < sizeof(extract_pointer_buffer)/sizeof(extract_pointer_buffer[0]); i++){
		*extract_pointer_buffer[i] = *(buffer + pos + i*2) << 8 | *(buffer + pos + 1 + i*2);
	}
}

static void print_buffer(uint8_t *buffer, uint8_t len){
	// Print full message
	for (size_t i = 0; i < len; i++) {
        printk("%02X ", *(buffer + i));
    }
	printk("\n");	
}
```

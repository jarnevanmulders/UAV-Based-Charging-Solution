## firmware/power-receiving-unit/build/Kconfig/Kconfig.shield
```kconfig
osource "/Users/jarne/Documents/GitHub/IoT_energystorage_charger_ble/wpt-receiver/boards/shields/*/Kconfig.shield"
osource "/ncs/v2.4.0/zephyr/boards/arm/boards/shields/*/Kconfig.shield"
osource "c:/users/jarne/documents/github/iot_energystorage_charger_ble/firmware/power-receiving-unit/boards/shields/*/Kconfig.shield"
osource "C:/ncs/v2.4.0/nrf/boards/shields/*/Kconfig.shield"
```

## firmware/power-receiving-unit/build/Kconfig/Kconfig.shield.defconfig
```kconfig
osource "/Users/jarne/Documents/GitHub/IoT_energystorage_charger_ble/wpt-receiver/boards/shields/*/Kconfig.defconfig"
osource "/ncs/v2.4.0/zephyr/boards/arm/boards/shields/*/Kconfig.defconfig"
osource "c:/users/jarne/documents/github/iot_energystorage_charger_ble/firmware/power-receiving-unit/boards/shields/*/Kconfig.defconfig"
osource "C:/ncs/v2.4.0/nrf/boards/shields/*/Kconfig.defconfig"
```

## firmware/power-transmitting-unit/build/Kconfig/Kconfig.shield
```kconfig
osource "c:/users/jarne/documents/github/iot_energystorage_charger_ble/firmware/power-transmitting-unit/boards/shields/*/Kconfig.shield"
osource "C:/ncs/v2.4.0/nrf/boards/shields/*/Kconfig.shield"
```

## firmware/power-transmitting-unit/build/Kconfig/Kconfig.shield.defconfig
```kconfig
osource "c:/users/jarne/documents/github/iot_energystorage_charger_ble/firmware/power-transmitting-unit/boards/shields/*/Kconfig.defconfig"
osource "C:/ncs/v2.4.0/nrf/boards/shields/*/Kconfig.defconfig"
```

## wpt-receiver/boards/boards/arm/wpt_reciever_board/Kconfig.defconfig
```kconfig
# Copyright (c) 2023 Nordic Semiconductor ASA
# SPDX-License-Identifier: Apache-2.0

if BOARD_WPT_RECIEVER_BOARD

config BOARD
	default "wpt_reciever_board"

config BT_CTLR
   default BT

endif
```
